#include <dt-bindings/interrupt-controller/arm-gic.h>
#include <dt-bindings/interrupt-controller/irq.h>
#include <dt-bindings/pinctrl/mt6765-pinfunc.h>
#include <dt-bindings/clock/mt6765-clk.h>
/dts-v1/;
/plugin/;

#include "huawei_common/huawei_common.dtsi"
#include "huawei_mt6762R_med_lx2_va/huawei.dtsi"

&rootparam {
    mtk,boardid = <4 4 0 4>;
    mtk,board_name = "MED_LX2_VA";
    mtk,product_name = "MED-LX2";
    hardware_version = "HL2MEDM";
};

&antenna_boardid_detect {
    expect_value = <2097>;
};

#include <k62v1_64_mex_a32/cust.dtsi>
#include "huawei_mt6762R_med_lx2_va/huawei-camera.dtsi"
&i2c5 {
	clock-frequency = <400000>;
};
/*End of this file, DO NOT ADD ANYTHING HERE*/

