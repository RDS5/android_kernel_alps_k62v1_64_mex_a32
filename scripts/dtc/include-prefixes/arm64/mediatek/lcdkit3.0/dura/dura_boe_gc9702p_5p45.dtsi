/* Copyright (c) 2013, The Linux Foundation. All rights reserved.
 *
 * This program is free software; you can redistribute it and/or modify
 * it under the terms of the GNU General Public License version 2 and
 * only version 2 as published by the Free Software Foundation.
 *
 * This program is distributed in the hope that it will be useful,
 * but WITHOUT ANY WARRANTY; without even the implied warranty of
 * MERCHANTABILITY or FITNESS FOR A PARTICULAR PURPOSE.  See the
 * GNU General Public License for more details.
 */

/*-------------------------------------------------------------------------
 * This file is autogenerated file using gcdb parser. Please do not edit it.
 * Update input XML file to add a new entry or update variable in this file
 * VERSION = 1.1
 *-----------------------------------------------------------------------*/
&huawei_lcd_config {
	dsi_dura_boe_gc9702p_5p45: lcd_kit_dura_boe_gc9702p_5p45 {
		compatible = "boe_gc9702p_5p45_720p_video";
		lcd-kit,panel-name = "BOE_GC9702P 5.45' VIDEO TFT 720 x 1440";
		lcd-kit,panel-type = <0x01>;
		lcd-kit,panel-xres = <720>;
		lcd-kit,panel-yres = <1440>;
		lcd-kit,panel-width = <62>;
		lcd-kit,panel-height = <124>;
		lcd-kit,panel-on-cmds = <0x29 0x01 0x00 0x00 0x0a 0x00 0x04 0xD5 0x61 0x74 0x97
		0x29 0x01 0x00 0x00 0x0a 0x00 0x02 0xD0 0x10
		0x29 0x01 0x00 0x00 0x0a 0x00 0x02 0x60 0x07
		0x29 0x01 0x00 0x00 0x0a 0x00 0x02 0x61 0x3f
		0x29 0x01 0x00 0x00 0x0a 0x00 0x02 0x62 0xc3
		0x29 0x01 0x00 0x00 0x0a 0x00 0x02 0x63 0x17
		0x29 0x01 0x00 0x00 0x0a 0x00 0x02 0x64 0x02
		0x29 0x01 0x00 0x00 0x0a 0x00 0x02 0x66 0x40
		0x29 0x01 0x00 0x00 0x0a 0x00 0x02 0x67 0x08
		0x29 0x01 0x00 0x00 0x0a 0x00 0x02 0x68 0xfB
		0x29 0x01 0x00 0x00 0x0a 0x00 0x02 0x69 0x02
		0x29 0x01 0x00 0x00 0x0a 0x00 0x02 0x6A 0x0C
		0x29 0x01 0x00 0x00 0x0a 0x00 0x02 0x6B 0x7E
		0x29 0x01 0x00 0x00 0x0a 0x00 0x02 0xb6 0x22
		0x29 0x01 0x00 0x00 0x0a 0x00 0x02 0xa5 0x1B
		0x29 0x01 0x00 0x00 0x0a 0x00 0x02 0xa1 0xFF
		0x29 0x01 0x00 0x00 0x0a 0x00 0x02 0xa4 0x55
		0x29 0x01 0x00 0x00 0x0a 0x00 0x02 0xa6 0x9C
		0x29 0x01 0x00 0x00 0x0a 0x00 0x02 0xa7 0x30
		0x29 0x01 0x00 0x00 0x0a 0x00 0x02 0xa0 0xAA
		0x29 0x01 0x00 0x00 0x0a 0x00 0x02 0xF1 0x54
		0x29 0x01 0x00 0x00 0x0a 0x00 0x02 0xF2 0x03
		0x29 0x01 0x00 0x00 0x0a 0x00 0x02 0xE8 0x0F
		0x29 0x01 0x00 0x00 0x0a 0x00 0x02 0xE9 0xFF
		0x29 0x01 0x00 0x00 0x0a 0x00 0x02 0xEA 0x4F
		0x29 0x01 0x00 0x00 0x0a 0x00 0x04 0x9D 0x9D 0x9D 0x9D
		0x29 0x01 0x00 0x00 0x0a 0x00 0x03 0xC1 0x01 0x5F
		0x29 0x01 0x00 0x00 0x0a 0x00 0x02 0xff 0xFF
		0x29 0x01 0x00 0x00 0x0a 0x00 0x02 0xff 0xFF
		0x29 0x01 0x00 0x00 0x0a 0x00 0x02 0xff 0xFF
		0x29 0x01 0x00 0x00 0x0a 0x00 0x02 0xff 0xFF
		0x29 0x01 0x00 0x00 0x0a 0x00 0x02 0xD0 0x11
		0x29 0x01 0x00 0x00 0x0a 0x00 0x02 0x60 0x06
		0x29 0x01 0x00 0x00 0x0a 0x00 0x02 0x62 0xC8
		0x29 0x01 0x00 0x00 0x0a 0x00 0x02 0x63 0x60
		0x29 0x01 0x00 0x00 0x0a 0x00 0x02 0x64 0x04
		0x29 0x01 0x00 0x00 0x0a 0x00 0x02 0x66 0x89
		0x29 0x01 0x00 0x00 0x0a 0x00 0x02 0x67 0x13
		0x29 0x01 0x00 0x00 0x0a 0x00 0x02 0x68 0x89
		0x29 0x01 0x00 0x00 0x0a 0x00 0x02 0x69 0xC3
		0x29 0x01 0x00 0x00 0x0a 0x00 0x03 0xB8 0x05 0x50
		0x29 0x01 0x00 0x00 0x0a 0x00 0x02 0xB9 0xC3
		0x29 0x01 0x00 0x00 0x0a 0x00 0x02 0xB7 0x07
		0x29 0x01 0x00 0x00 0x0a 0x00 0x03 0xBC 0x00 0x1B
		0x29 0x01 0x00 0x00 0x0a 0x00 0x2D 0xB3 0x35 0x36 0x07 0x01 0x24 0x26 0x18 0x1A 0x3F 0x3F 0x3F 0x3F 0x3F 0x3F 0x3F 0x3F 0x3F 0x34 0x34 0x34 0x33 0x38 0x35 0x36 0x06 0x00 0x14 0x16 0x08 0x0A 0x3F 0x3F 0x3F 0x3F 0x3F 0x3F 0x3F 0x3F 0x3F 0x34 0x34 0x34 0x33 0x38
		0x29 0x01 0x00 0x00 0x0a 0x00 0x09 0xA0 0x30 0x13 0x15 0x6D 0x30 0x14 0x15 0x6D
		0x29 0x01 0x00 0x00 0x0a 0x00 0x09 0xA3 0x30 0x15 0x15 0x6D 0x30 0x16 0x15 0x6D
		0x29 0x01 0x00 0x00 0x0a 0x00 0x06 0xA7 0x33 0x15 0x6D 0x15 0x6D
		0x29 0x01 0x00 0x00 0x0a 0x00 0x0B 0xA8 0x00 0x15 0x05 0xBD 0x03 0x00 0x16 0x05 0xBE 0x03
		0x29 0x01 0x00 0x00 0x0a 0x00 0x0B 0xA9 0x00 0x17 0x05 0xBF 0x03 0x00 0x18 0x05 0xC0 0x03
		0x29 0x01 0x00 0x00 0x0a 0x00 0x0B 0xAE 0x00 0x19 0x05 0xC1 0x03 0x00 0x1A 0x05 0xC2 0x03
		0x29 0x01 0x00 0x00 0x0a 0x00 0x0B 0xAF 0x00 0x1B 0x05 0xC3 0x03 0x00 0x1C 0x05 0xC4 0x03
		0x29 0x01 0x00 0x00 0x0a 0x00 0x08 0xB0 0x12 0x22 0x12 0x22 0x22 0x22 0x44
		0x29 0x01 0x00 0x00 0x0a 0x00 0x04 0xE7 0x01 0x01 0x6F
		0x29 0x01 0x00 0x00 0x0a 0x00 0x02 0xED 0x07
		0x29 0x01 0x00 0x00 0x0a 0x00 0x02 0xEE 0x75
		0x29 0x01 0x00 0x00 0x0a 0x00 0x04 0xE6 0xE7 0x1A 0x70
		0x29 0x01 0x00 0x00 0x0a 0x00 0x14 0xF1 0x7F 0x73 0x69 0x60 0x61 0x54 0x5a 0x44 0x5c 0x57 0x4f 0x65 0x4c 0x51 0x40 0x3A 0x35 0x26 0x00
		0x29 0x01 0x00 0x00 0x0a 0x00 0x14 0xF2 0x7F 0x73 0x69 0x60 0x61 0x54 0x5a 0x44 0x5c 0x57 0x4f 0x65 0x4c 0x51 0x40 0x3A 0x35 0x26 0x00
		0x29 0x01 0x00 0x00 0x0a 0x00 0x03 0xE3 0x00 0x00
		0x29 0x01 0x00 0x00 0x0a 0x00 0x02 0xC2 0x00
		0x29 0x01 0x00 0x00 0x0a 0x00 0x02 0xff 0xFF
		0x29 0x01 0x00 0x00 0x0a 0x00 0x02 0xff 0xFF
		0x29 0x01 0x00 0x00 0x0a 0x00 0x02 0xff 0xFF
		0x29 0x01 0x00 0x00 0x0a 0x00 0x02 0xff 0xFF
		0x29 0x01 0x00 0x00 0x0a 0x00 0x02 0xD0 0x00
		0x29 0x01 0x00 0x00 0x0a 0x00 0x02 0xff 0xFF
		0x29 0x01 0x00 0x00 0x0a 0x00 0x02 0x53 0x24
		0x29 0x01 0x00 0x00 0x0a 0x00 0x02 0x51 0x00
		0x29 0x01 0x00 0x00 0x64 0x01 0x02 0x11 0x00
		0x29 0x01 0x00 0x00 0x01 0x01 0x02 0x29 0x00>;
		lcd-kit,panel-on-cmds-state = "dsi_lp_mode";
		lcd-kit,panel-off-cmds = <0x05 0x01 0x00 0x00 0x14 0x01 0x02 0x28 0x00
		0x05 0x01 0x00 0x00 0x3c 0x01 0x02 0x10 0x00>;
		lcd-kit,panel-off-cmds-state = "dsi_lp_mode";
		lcd-kit,backlight-cmds = <0x15 0x01 0x00 0x00 0x00 0x00 0x02 0x51 0x00>;
		lcd-kit,backlight-cmds-state = "dsi_lp_mode";
		lcd-kit,tp-color-cmds = <0x06 0x01 0x00 0x00 0x0a 0x00 0x01 0xda>;
		lcd-kit,inversion-dot-cmds = <0x29 0x01 0x00 0x00 0x05 0x01 0x02 0xB7 0x03>;
		lcd-kit,inversion-column-cmds = <0x29 0x01 0x00 0x00 0x05 0x01 0x02 0xB7 0x04>;
		lcd-kit,esd-reg-cmds = <0x06 0x01 0x00 0x00 0x0a 0x00 0x01 0x0a
				0x06 0x01 0x00 0x00 0x0a 0x00 0x01 0x0d>;
		lcd-kit,esd-reg-cmds-state = "dsi_lp_mode";
		lcd-kit,esd-value = <0x9c 0x00>;
		lcd-kit,check-reg-cmds = <0x06 0x01 0x00 0x00 0x0a 0x00 0x01 0x0a>;
		lcd-kit,check-reg-cmds-state = "dsi_lp_mode";
		lcd-kit,check-reg-value = <0x9c>;
		lcd-kit,barcode-2d-cmds = <>;
		lcd-kit,project-id-cmds = <>;
		lcd-kit,project-id-cmds-state = "dsi_lp_mode";
		lcd-kit,panel-bl-maxnit-command = <0x06 0x01 0x00 0x00 0x0a 0x00 0x01 0xdb>;
		lcd-kit,panel-bl-maxnit-command-state = "dsi_lp_mode";
		lcd-kit,panel-lcm-type = <2>;
		lcd-kit,panel-ldi-dsi-mode = <1>;
		lcd-kit,panel-dsi-switch-mode = <0>;
		lcd-kit,panel-dsi-switch-mode-en = <0>;
		lcd-kit,panel-ldi-trans-seq = <0>;
		lcd-kit,panel-ldi-data-padding = <0>;
		lcd-kit,panel-ldi-packet-size = <256>;
		lcd-kit,panel-ldi-ps = <2>;
		lcd-kit,panel-vfp-lp = <0>;
		lcd-kit,panel-fbk-div = <1>;
		lcd-kit,panel-orientation = <1>;
		lcd-kit,panel-bpp = <2>;
		lcd-kit,panel-bgr-fmt = <0>;
		lcd-kit,panel-cmd-type = <8>;
		lcd-kit,panel-pxl-clk = <0>;
		lcd-kit,panel-pxl-clk-div = <0>;
		lcd-kit,panel-data-rate = <672>;
		lcd-kit,mipi-lane-nums = <3>;
		lcd-kit,h-back-porch = <72>;
		lcd-kit,h-front-porch = <60>;
		lcd-kit,h-pulse-width = <8>;
		lcd-kit,project-id-support = <0>;
		lcd-kit,default-project-id = "Y1639J1700";
		lcd-kit,v-back-porch = <40>;
		lcd-kit,v-front-porch = <40>;
		lcd-kit,v-pulse-width = <8>;
		lcd-kit,mipi-clk-post-adjust = <0>;
		lcd-kit,mipi-lp11-flag = <0>;
		lcd-kit,esd-support = <1>;
		lcd-kit,esd-recovery-bl-support = <1>;
		lcd-kit,tp-color-support = <0>;
		lcd-kit,lcd-vsp = <2 150 5500000>;
		lcd-kit,lcd-vsn = <2 151 5500000>;
		lcd-kit,lcd-reset = <2 45 0>;
		lcd-kit,power-on-stage = <3 1 0
				4 1 5
				11 1 0
				5 1 10
				5 2 1
				5 1 10
				7 1 0
				6 1 0
				8 1 0>;
		lcd-kit,lp-on-stage = <0 0 0>;
		lcd-kit,hs-on-stage = <0 0 0>;
		lcd-kit,hs-off-stage = <0 0 0>;
		lcd-kit,lp-off-stage = <0 0 0>;
		lcd-kit,power-off-stage = <7 0 0
				6 0 0
				8 0 0
				5 0 10
				4 0 0
				3 0 6>;
		lcd-kit,pt-support = <1>;
		lcd-kit,panel-density = <320>;
		lcd-kit,ssc-disable = <0>;
		lcd-kit,ssc-range = <3>;
		lcd-kit,inversion-support = <1>;
		lcd-kit,check-reg-support = <1>;
		lcd-kit,panel-bl-min = <3>;
		lcd-kit,panel-bl-max = <255>;
		lcd-kit,panel-bl-max-nit = <450>;
		lcd-kit,mipi-non-continue-enable = <1>;
		lcd-kit,panel-getblmaxnit-type = <1>;
		lcd-kit,panel-bl-ic-ctrl-type = <8>;
		lcd-kit,panel-bias-ic-ctrl-type = <3>;
		lcd-kit,oem-info-support = <0>;
		lcd-kit,oem-barcode-2d-support = <0>;
		lcd-kit,oem-barcode-2d-num-offset = <0>;
		lcd-kit,panel-on-always-reset = <1>;
		lcd-kit,panel-gpio-offset = <329>;
    };
};