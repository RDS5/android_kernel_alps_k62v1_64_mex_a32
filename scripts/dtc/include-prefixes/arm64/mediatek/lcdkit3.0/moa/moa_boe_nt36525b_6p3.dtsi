/* Copyright (c) 2013, The Linux Foundation. All rights reserved.
 *
 * This program is free software; you can redistribute it and/or modify
 * it under the terms of the GNU General Public License version 2 and
 * only version 2 as published by the Free Software Foundation.
 *
 * This program is distributed in the hope that it will be useful,
 * but WITHOUT ANY WARRANTY; without even the implied warranty of
 * MERCHANTABILITY or FITNESS FOR A PARTICULAR PURPOSE.  See the
 * GNU General Public License for more details.
 */

/*-------------------------------------------------------------------------
 * This file is autogenerated file using gcdb parser. Please do not edit it.
 * Update input XML file to add a new entry or update variable in this file
 * VERSION = 1.1
 *-----------------------------------------------------------------------*/
&huawei_lcd_config {
	dsi_moa_boe_nt36525b_6p3: lcd_kit_moa_boe_nt36525b_6p3 {
		compatible = "boe_nt36525b_6p3_720p_video";
		lcd-kit,panel-name = "BOE_NT36525B 6.3' VIDEO TFT 720 x 1600";
		lcd-kit,panel-type = <0x01>;
		lcd-kit,panel-xres = <720>;
		lcd-kit,panel-yres = <1600>;
		lcd-kit,panel-width = <67>;
		lcd-kit,panel-height = <145>;
		lcd-kit,panel-on-cmds = <0x29 0x01 0x00 0x00 0x0a 0x00 0x02 0xFF 0x10
		0x29 0x01 0x00 0x00 0x0a 0x00 0x02 0xFB 0x01
		0x29 0x01 0x00 0x00 0x0a 0x00 0x02 0xBA 0x02
		0x05 0x01 0x00 0x00 0x50 0x01 0x02 0x11 0x00
		0x05 0x01 0x00 0x00 0x28 0x00 0x02 0x29 0x00>;
		lcd-kit,panel-on-cmds-state = "dsi_lp_mode";
		lcd-kit,panel-off-cmds = <0x05 0x01 0x00 0x00 0x14 0x01 0x02 0x28 0x00
		0x05 0x01 0x00 0x00 0x32 0x01 0x02 0x10 0x00>;
		lcd-kit,panel-off-cmds-state = "dsi_lp_mode";
		lcd-kit,tp-color-cmds = <0x06 0x01 0x00 0x00 0x0a 0x00 0x01 0xda>;
		lcd-kit,inversion-dot-cmds = <0x29 0x01 0x00 0x00 0x0a 0x00 0x02 0xFF 0x24
		0x29 0x01 0x00 0x00 0x0a 0x00 0x02 0xFB 0x01
		0x29 0x01 0x00 0x00 0x0a 0x00 0x02 0x9B 0x00
		0x29 0x01 0x00 0x00 0x0a 0x00 0x02 0xFF 0x10>;
		lcd-kit,inversion-column-cmds = <0x29 0x01 0x00 0x00 0x0a 0x00 0x02 0xFF 0x24
		0x29 0x01 0x00 0x00 0x0a 0x00 0x02 0xFB 0x01
		0x29 0x01 0x00 0x00 0x0a 0x00 0x02 0x9B 0x0F
		0x29 0x01 0x00 0x00 0x0a 0x00 0x02 0xFF 0x10>;
		lcd-kit,esd-reg-cmds = <0x06 0x01 0x00 0x00 0x0a 0x00 0x01 0x0a>;
		lcd-kit,esd-reg-cmds-state = "dsi_lp_mode";
		lcd-kit,esd-value = <0x9c>;
		lcd-kit,check-reg-cmds = <0x06 0x01 0x00 0x00 0x0a 0x00 0x01 0x0a>;
		lcd-kit,check-reg-cmds-state = "dsi_lp_mode";
		lcd-kit,check-reg-value = <0x9c>;
		lcd-kit,barcode-2d-cmds = <0x29 0x01 0x00 0x00 0x0a 0x00 0x02 0xFF 0x22
		0x29 0x01 0x00 0x00 0x0a 0x00 0x02 0xFB 0x01
		0x06 0x01 0x00 0x00 0x0a 0x00 0x01 0x0A
		0x06 0x01 0x00 0x00 0x0a 0x00 0x01 0x0B
		0x06 0x01 0x00 0x00 0x0a 0x00 0x01 0x0C
		0x06 0x01 0x00 0x00 0x0a 0x00 0x01 0x0D
		0x06 0x01 0x00 0x00 0x0a 0x00 0x01 0x0E
		0x06 0x01 0x00 0x00 0x0a 0x00 0x01 0x0F
		0x06 0x01 0x00 0x00 0x0a 0x00 0x01 0x10
		0x06 0x01 0x00 0x00 0x0a 0x00 0x01 0x11
		0x06 0x01 0x00 0x00 0x0a 0x00 0x01 0x12
		0x06 0x01 0x00 0x00 0x0a 0x00 0x01 0x13
		0x06 0x01 0x00 0x00 0x0a 0x00 0x01 0x1B
		0x06 0x01 0x00 0x00 0x0a 0x00 0x01 0x1C
		0x06 0x01 0x00 0x00 0x0a 0x00 0x01 0x1D
		0x06 0x01 0x00 0x00 0x0a 0x00 0x01 0x1E
		0x06 0x01 0x00 0x00 0x0a 0x00 0x01 0x1F
		0x06 0x01 0x00 0x00 0x0a 0x00 0x01 0x20
		0x06 0x01 0x00 0x00 0x0a 0x00 0x01 0x21
		0x06 0x01 0x00 0x00 0x0a 0x00 0x01 0x22
		0x06 0x01 0x00 0x00 0x0a 0x00 0x01 0x23
		0x06 0x01 0x00 0x00 0x0a 0x00 0x01 0x24
		0x06 0x01 0x00 0x00 0x0a 0x00 0x01 0x25
		0x06 0x01 0x00 0x00 0x0a 0x00 0x01 0x26
		0x06 0x01 0x00 0x00 0x0a 0x00 0x01 0x27
		0x06 0x01 0x00 0x00 0x0a 0x00 0x01 0x28
		0x06 0x01 0x00 0x00 0x0a 0x00 0x01 0x29
		0x06 0x01 0x00 0x00 0x0a 0x00 0x01 0x2A
		0x06 0x01 0x00 0x00 0x0a 0x00 0x01 0x2B
		0x06 0x01 0x00 0x00 0x0a 0x00 0x01 0x2F
		0x06 0x01 0x00 0x00 0x0a 0x00 0x01 0x30
		0x06 0x01 0x00 0x00 0x0a 0x00 0x01 0x31
		0x06 0x01 0x00 0x00 0x0a 0x00 0x01 0x64
		0x06 0x01 0x00 0x00 0x0a 0x00 0x01 0x65
		0x06 0x01 0x00 0x00 0x0a 0x00 0x01 0x66
		0x06 0x01 0x00 0x00 0x0a 0x00 0x01 0x67
		0x06 0x01 0x00 0x00 0x0a 0x00 0x01 0x6B
		0x06 0x01 0x00 0x00 0x0a 0x00 0x01 0x70
		0x06 0x01 0x00 0x00 0x0a 0x00 0x01 0x71
		0x06 0x01 0x00 0x00 0x0a 0x00 0x01 0x7D
		0x06 0x01 0x00 0x00 0x0a 0x00 0x01 0x84
		0x06 0x01 0x00 0x00 0x0a 0x00 0x01 0x85
		0x06 0x01 0x00 0x00 0x0a 0x00 0x01 0x86
		0x06 0x01 0x00 0x00 0x0a 0x00 0x01 0x87
		0x06 0x01 0x00 0x00 0x0a 0x00 0x01 0x88
		0x06 0x01 0x00 0x00 0x0a 0x00 0x01 0x8C
		0x06 0x01 0x00 0x00 0x0a 0x00 0x01 0x8D
		0x06 0x01 0x00 0x00 0x0a 0x00 0x01 0x97
		0x06 0x01 0x00 0x00 0x0a 0x00 0x01 0x99
		0x29 0x01 0x00 0x00 0x0a 0x00 0x02 0xFF 0x10
		0x29 0x01 0x00 0x00 0x0a 0x00 0x02 0xFB 0x01>;
		lcd-kit,project-id-cmds = <0x29 0x01 0x00 0x00 0x0a 0x00 0x02 0xFF 0x22
		0x29 0x01 0x00 0x00 0x0a 0x00 0x02 0xFB 0x01
		0x06 0x01 0x00 0x00 0x0a 0x00 0x01 0x00
		0x06 0x01 0x00 0x00 0x0a 0x00 0x01 0x01
		0x06 0x01 0x00 0x00 0x0a 0x00 0x01 0x02
		0x06 0x01 0x00 0x00 0x0a 0x00 0x01 0x03
		0x06 0x01 0x00 0x00 0x0a 0x00 0x01 0x04
		0x06 0x01 0x00 0x00 0x0a 0x00 0x01 0x05
		0x06 0x01 0x00 0x00 0x0a 0x00 0x01 0x06
		0x06 0x01 0x00 0x00 0x0a 0x00 0x01 0x07
		0x06 0x01 0x00 0x00 0x0a 0x00 0x01 0x08
		0x06 0x01 0x00 0x00 0x0a 0x00 0x01 0x09
		0x29 0x01 0x00 0x00 0x0a 0x00 0x02 0xFF 0x10
		0x29 0x01 0x00 0x00 0x0a 0x00 0x02 0xFB 0x01>;
		lcd-kit,project-id-cmds-state = "dsi_lp_mode";
		lcd-kit,panel-bl-maxnit-command = <0x06 0x01 0x00 0x00 0x0a 0x00 0x01 0xdb>;
		lcd-kit,panel-bl-maxnit-command-state = "dsi_lp_mode";
		lcd-kit,panel-lcm-type = <2>;
		lcd-kit,panel-ldi-dsi-mode = <1>;
		lcd-kit,panel-dsi-switch-mode = <0>;
		lcd-kit,panel-dsi-switch-mode-en = <0>;
		lcd-kit,panel-ldi-trans-seq = <0>;
		lcd-kit,panel-ldi-data-padding = <0>;
		lcd-kit,panel-ldi-packet-size = <256>;
		lcd-kit,panel-ldi-ps = <2>;
		lcd-kit,panel-vfp-lp = <0>;
		lcd-kit,panel-fbk-div = <1>;
		lcd-kit,panel-orientation = <1>;
		lcd-kit,panel-bpp = <2>;
		lcd-kit,panel-bgr-fmt = <0>;
		lcd-kit,panel-cmd-type = <8>;
		lcd-kit,panel-pxl-clk = <0>;
		lcd-kit,panel-pxl-clk-div = <0>;
		lcd-kit,panel-data-rate = <669>;
		lcd-kit,mipi-lane-nums = <3>;
		lcd-kit,h-back-porch = <32>;
		lcd-kit,h-front-porch = <48>;
		lcd-kit,h-pulse-width = <16>;
		lcd-kit,project-id-support = <1>;
		lcd-kit,default-project-id = "Y1639I1300";
		lcd-kit,v-back-porch = <8>;
		lcd-kit,v-front-porch = <10>;
		lcd-kit,v-pulse-width = <2>;
		lcd-kit,mipi-clk-post-adjust = <0>;
		lcd-kit,mipi-lp11-flag = <0>;
		lcd-kit,esd-support = <0>;
		lcd-kit,tp-color-support = <0>;
		lcd-kit,lcd-vsp = <2 150 6000000>;
		lcd-kit,lcd-vsn = <2 151 6000000>;
		lcd-kit,lcd-reset = <2 45 0>;
		lcd-kit,power-on-stage = <5 2 2
				7 1 1
				3 1 3
				4 1 12
				5 1 2
				5 2 4
				5 1 15
				6 1 0
				8 1 0>;
		lcd-kit,lp-on-stage = <0 0 0>;
		lcd-kit,hs-on-stage = <0 0 0>;
		lcd-kit,hs-off-stage = <0 0 0>;
		lcd-kit,lp-off-stage = <0 0 0>;
		lcd-kit,power-off-stage = <7 0 0
				6 0 0
				8 0 0
				4 0 1
				3 0 5>;
		lcd-kit,pt-support = <1>;
		lcd-kit,panel-density = <320>;
		lcd-kit,ssc-disable = <1>;
		lcd-kit,inversion-support = <1>;
		lcd-kit,check-reg-support = <1>;
		lcd-kit,panel-bl-min = <30>;
		lcd-kit,panel-bl-max = <8400>;
		lcd-kit,panel-bl-max-nit = <450>;
		lcd-kit,mipi-non-continue-enable = <1>;
		lcd-kit,panel-getblmaxnit-type = <1>;
		lcd-kit,panel-bl-ic-ctrl-type = <6>;
		lcd-kit,panel-bias-ic-ctrl-type = <3>;
		lcd-kit,oem-info-support = <1>;
		lcd-kit,oem-barcode-2d-support = <1>;
		lcd-kit,oem-barcode-2d-num-offset = <1>;
		lcd-kit,panel-on-always-reset = <1>;
		lcd-kit,panel-gpio-offset = <329>;
    };
};