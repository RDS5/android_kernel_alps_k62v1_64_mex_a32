/*---------------------------------------------------------------------------
 * This file is autogenerated file using huawei LCD parser. Please do not edit it.
 * Update input XML file to add a new entry or update variable in this file
 * Parser location: vendor/huawei/chipset_common/devkit/lcdkit/tools 
 *---------------------------------------------------------------------------*/


#include "moa_auo_nt36572a_6p3.dtsi"
#include "moa_auo_otm1901a_5p2_1080p_video_default.dtsi"
#include "moa_boe_ili9881h_6p3.dtsi"
#include "moa_boe_nt36525b_6p3.dtsi"
#include "moa_inx_ili9881h_6p3.dtsi"
#include "moa_txd_ili9881h_6p3.dtsi"