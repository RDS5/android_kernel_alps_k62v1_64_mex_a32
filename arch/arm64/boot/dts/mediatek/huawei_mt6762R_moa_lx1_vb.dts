#include <dt-bindings/interrupt-controller/arm-gic.h>
#include <dt-bindings/interrupt-controller/irq.h>
#include <dt-bindings/pinctrl/mt6765-pinfunc.h>
#include <dt-bindings/clock/mt6765-clk.h>
/dts-v1/;
/plugin/;

#include "huawei_common/huawei_common.dtsi"
#include "huawei_mt6762R_moa_lx1_vb/huawei.dtsi"

&rootparam {
    mtk,boardid = <4 4 2 2>;
    mtk,board_name = "MOA_LX1_VB";
    mtk,product_name = "MOA-LX1";
    hardware_version = "HL1MEDM";
};

&antenna_boardid_detect {
    expect_value = <2017>;
};

&dev_detect{
    nfc = <1>;
};

#include <k62v1_64_mex_a32/cust.dtsi>
#include "huawei_mt6762R_moa_lx1_vb/huawei-camera.dtsi"
&i2c5 {
	clock-frequency = <400000>;
};
/*End of this file, DO NOT ADD ANYTHING HERE*/

