#include "huawei-led.dtsi"
#include "huawei-tp.dtsi"
#include "huawei-charger.dtsi"
#include "huawei-fingerprint.dtsi"
#include "huawei-wifi.dtsi"
#include "huawei-lcd.dtsi"
#include "huawei-gnss.dtsi"
#include "huawei-scp.dtsi"
#include "huawei_sw_thermal_node.dtsi"
#include "huawei-audio.dtsi"
#include "kobe2_thermal_ntc_new.dtsi"
