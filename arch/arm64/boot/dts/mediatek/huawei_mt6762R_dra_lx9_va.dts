#include <dt-bindings/interrupt-controller/arm-gic.h>
#include <dt-bindings/interrupt-controller/irq.h>
#include <dt-bindings/pinctrl/mt6765-pinfunc.h>
#include <dt-bindings/clock/mt6765-clk.h>
/dts-v1/;
/plugin/;

#include "huawei_common/huawei_common.dtsi"
#include "huawei_mt6762R_dra_lx9_va/huawei.dtsi"

&rootparam {
    mtk,boardid = <4 5 2 9>;
    mtk,board_name = "DRA_LX9_VA";
    mtk,product_name = "DRA-LX9";
    hardware_version = "HL1DUAM";
};

&antenna_boardid_detect {
    status = "disable";
};

#include <k62v1_64_mex_a32/cust.dtsi>
&i2c5 {
        clock-frequency = <400000>;
};
/*End of this file, DO NOT ADD ANYTHING HERE*/

