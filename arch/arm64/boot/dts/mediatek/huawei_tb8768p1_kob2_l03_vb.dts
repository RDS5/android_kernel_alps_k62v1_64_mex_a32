#include <dt-bindings/interrupt-controller/arm-gic.h>
#include <dt-bindings/interrupt-controller/irq.h>
#include <dt-bindings/pinctrl/mt6765-pinfunc.h>
#include <dt-bindings/clock/mt6765-clk.h>
/dts-v1/;
/plugin/;

#include "huawei_common/huawei_common.dtsi"
#include "huawei_tb8768p1_kob2_l03_vb/huawei.dtsi"

&rootparam {
    mtk,boardid = <4 2 6 4>;
    mtk,board_name = "KOB2_L03_VB";
    mtk,product_name = "KOB2-L03";
    hardware_version = "SH1KOBE2M02";
};

&antenna_boardid_detect {
    expect_value = <2081>;
};

&card_tray_detect {
    card_tray_gpio = <376>;
};

#include <tb8768p1_64_a32/cust.dtsi>
#include "huawei_tb8768p1_kob2_l03_vb/huawei-camera.dtsi"
&i2c5 {
	clock-frequency = <400000>;
};
/*End of this file, DO NOT ADD ANYTHING HERE*/

