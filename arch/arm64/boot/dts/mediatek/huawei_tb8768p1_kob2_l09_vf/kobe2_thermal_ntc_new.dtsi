/*
 * Copyright (C) 2018 MediaTek Inc.
 *
 * This program is free software; you can redistribute it and/or modify
 * it under the terms of the GNU General Public License version 2 as
 * published by the Free Software Foundation.
 *
 * This program is distributed in the hope that it will be useful,
 * but WITHOUT ANY WARRANTY; without even the implied warranty of
 * MERCHANTABILITY or FITNESS FOR A PARTICULAR PURPOSE.
 * See http://www.gnu.org/licenses/gpl-2.0.html for more details.
 */


&therm_ntc_bts {
		compatible = "mediatek,therm_ntc_bts";
		PUP_R = <37400>;
		PUP_VOLT = <1800>;
		OVER_CRITICAL_L = <195652>;
		NTC_TABLE = <8>;
		AUXADC_CH = <0>;
};

&therm_ntc_btsmdpa {
		compatible = "mediatek,therm_ntc_btsmdpa";
		PUP_R = <37400>;
		PUP_VOLT = <1800>;
		OVER_CRITICAL_L = <195652>;
		NTC_TABLE = <8>;
		AUXADC_CH = <1>;
};

&therm_ntc_usb {
		compatible = "mediatek,therm_ntc_usb";
		PUP_R = <37400>;
		PUP_VOLT = <1800>;
		OVER_CRITICAL_L = <195652>;
		NTC_TABLE = <8>;
		AUXADC_CH = <3>;
};

&therm_ntc_charger {
		compatible = "mediatek,therm_ntc_charger";
};

