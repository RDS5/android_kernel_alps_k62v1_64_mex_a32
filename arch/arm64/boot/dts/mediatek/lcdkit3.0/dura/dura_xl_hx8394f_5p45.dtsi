/* Copyright (c) 2013, The Linux Foundation. All rights reserved.
 *
 * This program is free software; you can redistribute it and/or modify
 * it under the terms of the GNU General Public License version 2 and
 * only version 2 as published by the Free Software Foundation.
 *
 * This program is distributed in the hope that it will be useful,
 * but WITHOUT ANY WARRANTY; without even the implied warranty of
 * MERCHANTABILITY or FITNESS FOR A PARTICULAR PURPOSE.  See the
 * GNU General Public License for more details.
 */

/*-------------------------------------------------------------------------
 * This file is autogenerated file using gcdb parser. Please do not edit it.
 * Update input XML file to add a new entry or update variable in this file
 * VERSION = 1.1
 *-----------------------------------------------------------------------*/
&huawei_lcd_config {
	dsi_dura_xl_hx8394f_5p45: lcd_kit_dura_xl_hx8394f_5p45 {
		compatible = "xl_hx8394f_5p45_720p_video";
		lcd-kit,panel-name = "XL_HX8394F 5.45' VIDEO TFT 720 x 1440";
		lcd-kit,panel-type = <0x01>;
		lcd-kit,panel-xres = <720>;
		lcd-kit,panel-yres = <1440>;
		lcd-kit,panel-width = <62>;
		lcd-kit,panel-height = <124>;
		lcd-kit,panel-on-cmds = <0x29 0x01 0x00 0x00 0x0a 0x00 0x04 0xB9 0xFF 0x83 0x94
		0x29 0x01 0x00 0x00 0x0a 0x00 0x07 0xBA 0x62 0x03 0x68 0x7B 0xB2 0xC0
		0x29 0x01 0x00 0x00 0x0a 0x00 0x0B 0xB1 0x48 0x12 0x72 0x09 0x31 0x24 0x71 0x71 0x50 0x43
		0x29 0x01 0x00 0x00 0x0a 0x00 0x07 0xB2 0x00 0x80 0x78 0x06 0x08 0x22
		0x29 0x01 0x00 0x00 0x0a 0x00 0x16 0xB4 0x01 0x62 0x64 0x62 0x61 0x62 0x01 0x0C 0x6D 0x33 0x00 0x3F 0x01 0x62 0x64 0x62 0x61 0x62 0x01 0x0C 0x6D
		0x29 0x01 0x00 0x00 0x0a 0x00 0x23 0xD3 0x00 0x00 0x04 0x04 0x00 0x00 0x3F 0x3F 0x32 0x10 0x01 0x00 0x01 0x52 0x15 0xA7 0x05 0xA7 0x32 0x10 0x00 0x00 0x00 0x67 0x43 0x06 0x06 0x27 0x0D 0x0D 0x27 0x06 0x40 0x00
		0x29 0x01 0x00 0x00 0x0a 0x00 0x3B 0xE0 0x00 0x04 0x0D 0x14 0x18 0x1D 0x21 0x20 0x42 0x55 0x65 0x64 0x6B 0x7B 0x7D 0x7F 0x8C 0x90 0x8D 0x9E 0xAF 0x57 0x56 0x59 0x5D 0x61 0x68 0x7B 0x7F 0x00 0x04 0x0D 0x14 0x18 0x1D 0x21 0x20 0x42 0x55 0x65 0x64 0x6B 0x7B 0x7D 0x7F 0x8C 0x90 0x8D 0x9E 0xAF 0x57 0x56 0x59 0x5D 0x61 0x68 0x7B 0x7F
		0x29 0x01 0x00 0x00 0x0a 0x00 0x03 0xB6 0x45 0x45
		0x29 0x01 0x00 0x00 0x0a 0x00 0x02 0xBD 0x02
		0x29 0x01 0x00 0x00 0x0a 0x00 0x05 0xD3 0x01 0x04 0x00 0x01
		0x29 0x01 0x00 0x00 0x0a 0x00 0x02 0xBD 0x00
		0x29 0x01 0x00 0x00 0x0a 0x00 0x2D 0xD5 0x19 0x19 0x24 0x25 0x18 0x18 0x18 0x18 0x06 0x07 0x04 0x05 0x02 0x03 0x00 0x01 0x20 0x21 0x18 0x18 0x18 0x18 0x18 0x18 0x18 0x18 0x18 0x18 0x18 0x18 0x18 0x18 0x18 0x18 0x18 0x18 0x18 0x18 0x18 0x18 0x18 0x18 0x18 0x18
		0x29 0x01 0x00 0x00 0x0a 0x00 0x2D 0xD6 0x18 0x18 0x21 0x20 0x19 0x19 0x18 0x18 0x01 0x00 0x03 0x02 0x05 0x04 0x07 0x06 0x25 0x24 0x18 0x18 0x18 0x18 0x18 0x18 0x18 0x18 0x18 0x18 0x18 0x18 0x18 0x18 0x18 0x18 0x18 0x18 0x18 0x18 0x18 0x18 0x18 0x18 0x18 0x18
		0x29 0x01 0x00 0x00 0x0a 0x00 0x02 0xCC 0x0B
		0x29 0x01 0x00 0x00 0x0a 0x00 0x03 0xC0 0x1F 0x31
		0x29 0x01 0x00 0x00 0x0a 0x00 0x02 0xD2 0x77
		0x29 0x01 0x00 0x00 0x0a 0x00 0x02 0xD4 0x02
		0x29 0x01 0x00 0x00 0x0a 0x00 0x02 0xC6 0xED
		0x29 0x01 0x00 0x00 0x0a 0x00 0x04 0xC9 0x03 0x00 0x25
		0x29 0x01 0x00 0x00 0x0a 0x00 0x02 0x53 0x24
		0x29 0x01 0x00 0x00 0x0a 0x00 0x02 0x51 0x00


		0x29 0x01 0x00 0x00 0x78 0x01 0x02 0x11 0x00
		0x29 0x01 0x00 0x00 0x14 0x01 0x02 0x29 0x00>;
		lcd-kit,panel-on-cmds-state = "dsi_lp_mode";
		lcd-kit,panel-off-cmds = <0x05 0x01 0x00 0x00 0x20 0x01 0x02 0x28 0x00
		0x05 0x01 0x00 0x00 0x20 0x01 0x02 0x10 0x00>;
		lcd-kit,panel-off-cmds-state = "dsi_lp_mode";
		lcd-kit,backlight-cmds = <0x15 0x01 0x00 0x00 0x00 0x00 0x02 0x51 0x00>;
		lcd-kit,backlight-cmds-state = "dsi_lp_mode";
		lcd-kit,tp-color-cmds = <0x06 0x01 0x00 0x00 0x0a 0x00 0x01 0xda>;
		lcd-kit,inversion-dot-cmds = <0x29 0x01 0x00 0x00 0x05 0x01 0x07 0xB2 0x03 0x80 0x78 0x06 0x08 0x22>;
		lcd-kit,inversion-column-cmds = <0x29 0x01 0x00 0x00 0x05 0x01 0x07 0xB2 0x00 0x80 0x78 0x06 0x08 0x22>;
		lcd-kit,esd-reg-cmds = <0x06 0x01 0x00 0x00 0x0a 0x00 0x01 0x0a>;
		lcd-kit,esd-reg-cmds-state = "dsi_lp_mode";
		lcd-kit,esd-value = <0x1c>;
		lcd-kit,check-reg-cmds = <0x06 0x01 0x00 0x00 0x0a 0x00 0x01 0x0a>;
		lcd-kit,check-reg-cmds-state = "dsi_lp_mode";
		lcd-kit,check-reg-value = <0x1c>;
		lcd-kit,barcode-2d-cmds = <>;
		lcd-kit,project-id-cmds = <>;
		lcd-kit,project-id-cmds-state = "dsi_lp_mode";
		lcd-kit,panel-bl-maxnit-command = <0x06 0x01 0x00 0x00 0x0a 0x00 0x01 0xdb>;
		lcd-kit,panel-bl-maxnit-command-state = "dsi_lp_mode";
		lcd-kit,panel-lcm-type = <2>;
		lcd-kit,panel-ldi-dsi-mode = <1>;
		lcd-kit,panel-dsi-switch-mode = <0>;
		lcd-kit,panel-dsi-switch-mode-en = <0>;
		lcd-kit,panel-ldi-trans-seq = <0>;
		lcd-kit,panel-ldi-data-padding = <0>;
		lcd-kit,panel-ldi-packet-size = <256>;
		lcd-kit,panel-ldi-ps = <2>;
		lcd-kit,panel-vfp-lp = <0>;
		lcd-kit,panel-fbk-div = <1>;
		lcd-kit,panel-orientation = <1>;
		lcd-kit,panel-bpp = <2>;
		lcd-kit,panel-bgr-fmt = <0>;
		lcd-kit,panel-cmd-type = <8>;
		lcd-kit,panel-pxl-clk = <0>;
		lcd-kit,panel-pxl-clk-div = <0>;
		lcd-kit,panel-data-rate = <672>;
		lcd-kit,mipi-lane-nums = <3>;
		lcd-kit,h-back-porch = <80>;
		lcd-kit,h-front-porch = <96>;
		lcd-kit,h-pulse-width = <10>;
		lcd-kit,project-id-support = <0>;
		lcd-kit,default-project-id = "Y1639J1700";
		lcd-kit,v-back-porch = <14>;
		lcd-kit,v-front-porch = <15>;
		lcd-kit,v-pulse-width = <4>;
		lcd-kit,mipi-clk-post-adjust = <0>;
		lcd-kit,mipi-lp11-flag = <0>;
		lcd-kit,esd-support = <1>;
		lcd-kit,esd-recovery-bl-support = <1>;
		lcd-kit,tp-color-support = <0>;
		lcd-kit,lcd-vsp = <2 150 5500000>;
		lcd-kit,lcd-vsn = <2 151 5500000>;
		lcd-kit,lcd-reset = <2 45 0>;
		lcd-kit,power-on-stage = <3 1 0
				4 1 5
				11 1 0
				5 1 5
				5 2 5
				5 1 50
				7 1 0
				6 1 0
				8 1 0>;
		lcd-kit,lp-on-stage = <0 0 0>;
		lcd-kit,hs-on-stage = <0 0 0>;
		lcd-kit,hs-off-stage = <0 0 0>;
		lcd-kit,lp-off-stage = <0 0 0>;
		lcd-kit,power-off-stage = <7 0 0
				6 0 0
				8 0 0
				5 0 10
				4 0 0
				3 0 6>;
		lcd-kit,pt-support = <1>;
		lcd-kit,panel-density = <320>;
		lcd-kit,ssc-disable = <0>;
		lcd-kit,ssc-range = <3>;
		lcd-kit,inversion-support = <1>;
		lcd-kit,check-reg-support = <1>;
		lcd-kit,panel-bl-min = <3>;
		lcd-kit,panel-bl-max = <255>;
		lcd-kit,panel-bl-max-nit = <450>;
		lcd-kit,mipi-non-continue-enable = <1>;
		lcd-kit,panel-getblmaxnit-type = <1>;
		lcd-kit,panel-bl-ic-ctrl-type = <8>;
		lcd-kit,panel-bias-ic-ctrl-type = <3>;
		lcd-kit,oem-info-support = <0>;
		lcd-kit,oem-barcode-2d-support = <0>;
		lcd-kit,oem-barcode-2d-num-offset = <0>;
		lcd-kit,panel-on-always-reset = <1>;
		lcd-kit,panel-gpio-offset = <329>;
    };
};