/*---------------------------------------------------------------------------
 * This file is autogenerated file using huawei LCD parser. Please do not edit it.
 * Update input XML file to add a new entry or update variable in this file
 * Parser location: vendor/huawei/chipset_common/devkit/lcdkit/tools 
 *---------------------------------------------------------------------------*/


#include "dura_auo_otm1901a_5p2_1080p_video_default.dtsi"
#include "dura_boe_gc9702p_5p45.dtsi"
#include "dura_boe_ili9881c_5p45.dtsi"
#include "dura_mdt_ili9881c_5p45.dtsi"
#include "dura_xl_hx8394f_5p45.dtsi"
#include "dura_xl_ili9881p_5p45.dtsi"