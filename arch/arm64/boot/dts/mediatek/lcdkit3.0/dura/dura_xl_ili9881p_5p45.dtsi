/* Copyright (c) 2013, The Linux Foundation. All rights reserved.
 *
 * This program is free software; you can redistribute it and/or modify
 * it under the terms of the GNU General Public License version 2 and
 * only version 2 as published by the Free Software Foundation.
 *
 * This program is distributed in the hope that it will be useful,
 * but WITHOUT ANY WARRANTY; without even the implied warranty of
 * MERCHANTABILITY or FITNESS FOR A PARTICULAR PURPOSE.  See the
 * GNU General Public License for more details.
 */

/*-------------------------------------------------------------------------
 * This file is autogenerated file using gcdb parser. Please do not edit it.
 * Update input XML file to add a new entry or update variable in this file
 * VERSION = 1.1
 *-----------------------------------------------------------------------*/
&huawei_lcd_config {
	dsi_dura_xl_ili9881p_5p45: lcd_kit_dura_xl_ili9881p_5p45 {
		compatible = "xl_ili9881p_5p45_720p_video";
		lcd-kit,panel-name = "XL_ILI9881P 5.45' VIDEO TFT 720 x 1440";
		lcd-kit,panel-type = <0x01>;
		lcd-kit,panel-xres = <720>;
		lcd-kit,panel-yres = <1440>;
		lcd-kit,panel-width = <62>;
		lcd-kit,panel-height = <124>;
		lcd-kit,panel-on-cmds = <0x29 0x01 0x00 0x00 0x0a 0x00 0x04 0xFF 0x98 0x81 0x06
		0x29 0x01 0x00 0x00 0x0a 0x00 0x02 0x01 0x03
		0x29 0x01 0x00 0x00 0x0a 0x00 0x02 0x2B 0x0A
		0x29 0x01 0x00 0x00 0x0a 0x00 0x02 0xC0 0xCF
		0x29 0x01 0x00 0x00 0x0a 0x00 0x02 0xC1 0x2A
		0x29 0x01 0x00 0x00 0x0a 0x00 0x02 0x04 0xE1
		0x29 0x01 0x00 0x00 0x0a 0x00 0x02 0x80 0x00
		0x29 0x01 0x00 0x00 0x0a 0x00 0x02 0x81 0x00
		0x29 0x01 0x00 0x00 0x0a 0x00 0x02 0x64 0x2F
		0x29 0x01 0x00 0x00 0x0a 0x00 0x04 0xFF 0x98 0x81 0x05
		0x29 0x01 0x00 0x00 0x0a 0x00 0x02 0xB2 0x70
		0x29 0x01 0x00 0x00 0x0a 0x00 0x02 0x1B 0x01
		0x29 0x01 0x00 0x00 0x0a 0x00 0x02 0xB1 0x70
		0x29 0x01 0x00 0x00 0x0a 0x00 0x02 0x78 0x01
		0x29 0x01 0x00 0x00 0x0a 0x00 0x02 0xA9 0xC0
		0x29 0x01 0x00 0x00 0x0a 0x00 0x02 0x1E 0x11
		0x29 0x01 0x00 0x00 0x0a 0x00 0x02 0x4C 0x11
		0x29 0x01 0x00 0x00 0x0a 0x00 0x02 0x38 0xA0
		0x29 0x01 0x00 0x00 0x0a 0x00 0x02 0x1A 0x50
		0x29 0x01 0x00 0x00 0x0a 0x00 0x02 0x54 0x28
		0x29 0x01 0x00 0x00 0x0a 0x00 0x02 0x55 0x25
		0x29 0x01 0x00 0x00 0x0a 0x00 0x02 0x56 0x38
		0x29 0x01 0x00 0x00 0x0a 0x00 0x02 0x57 0x38
		0x29 0x01 0x00 0x00 0x0a 0x00 0x02 0x4D 0x22
		0x29 0x01 0x00 0x00 0x0a 0x00 0x02 0x26 0x0E
		0x29 0x01 0x00 0x00 0x0a 0x00 0x02 0x1B 0x09
		0x29 0x01 0x00 0x00 0x0a 0x00 0x04 0xFF 0x98 0x81 0x02
		0x29 0x01 0x00 0x00 0x0a 0x00 0x02 0x42 0x01
		0x29 0x01 0x00 0x00 0x0a 0x00 0x02 0x44 0x01
		0x29 0x01 0x00 0x00 0x0a 0x00 0x02 0x01 0x50
		0x29 0x01 0x00 0x00 0x0a 0x00 0x02 0x15 0x10
		0x29 0x01 0x00 0x00 0x0a 0x00 0x04 0xFF 0x98 0x81 0x01
		0x29 0x01 0x00 0x00 0x0a 0x00 0x02 0x01 0x00
		0x29 0x01 0x00 0x00 0x0a 0x00 0x02 0x02 0x00
		0x29 0x01 0x00 0x00 0x0a 0x00 0x02 0x03 0x56
		0x29 0x01 0x00 0x00 0x0a 0x00 0x02 0x04 0x13
		0x29 0x01 0x00 0x00 0x0a 0x00 0x02 0x05 0x13
		0x29 0x01 0x00 0x00 0x0a 0x00 0x02 0x06 0x0a
		0x29 0x01 0x00 0x00 0x0a 0x00 0x02 0x07 0x05
		0x29 0x01 0x00 0x00 0x0a 0x00 0x02 0x08 0x05
		0x29 0x01 0x00 0x00 0x0a 0x00 0x02 0x09 0x1D
		0x29 0x01 0x00 0x00 0x0a 0x00 0x02 0x0a 0x01
		0x29 0x01 0x00 0x00 0x0a 0x00 0x02 0x0b 0x00
		0x29 0x01 0x00 0x00 0x0a 0x00 0x02 0x0c 0x3F
		0x29 0x01 0x00 0x00 0x0a 0x00 0x02 0x0d 0x29
		0x29 0x01 0x00 0x00 0x0a 0x00 0x02 0x0e 0x29
		0x29 0x01 0x00 0x00 0x0a 0x00 0x02 0x0f 0x1D
		0x29 0x01 0x00 0x00 0x0a 0x00 0x02 0x10 0x1D
		0x29 0x01 0x00 0x00 0x0a 0x00 0x02 0x11 0x00
		0x29 0x01 0x00 0x00 0x0a 0x00 0x02 0x12 0x00
		0x29 0x01 0x00 0x00 0x0a 0x00 0x02 0x13 0x08
		0x29 0x01 0x00 0x00 0x0a 0x00 0x02 0x14 0x08
		0x29 0x01 0x00 0x00 0x0a 0x00 0x02 0x15 0x00
		0x29 0x01 0x00 0x00 0x0a 0x00 0x02 0x16 0x00
		0x29 0x01 0x00 0x00 0x0a 0x00 0x02 0x17 0x00
		0x29 0x01 0x00 0x00 0x0a 0x00 0x02 0x18 0x00
		0x29 0x01 0x00 0x00 0x0a 0x00 0x02 0x19 0x00
		0x29 0x01 0x00 0x00 0x0a 0x00 0x02 0x1a 0x00
		0x29 0x01 0x00 0x00 0x0a 0x00 0x02 0x1b 0x00
		0x29 0x01 0x00 0x00 0x0a 0x00 0x02 0x1c 0x00
		0x29 0x01 0x00 0x00 0x0a 0x00 0x02 0x1d 0x00
		0x29 0x01 0x00 0x00 0x0a 0x00 0x02 0x1e 0x40
		0x29 0x01 0x00 0x00 0x0a 0x00 0x02 0x1f 0x88
		0x29 0x01 0x00 0x00 0x0a 0x00 0x02 0x20 0x08
		0x29 0x01 0x00 0x00 0x0a 0x00 0x02 0x21 0x01
		0x29 0x01 0x00 0x00 0x0a 0x00 0x02 0x22 0x00
		0x29 0x01 0x00 0x00 0x0a 0x00 0x02 0x23 0x00
		0x29 0x01 0x00 0x00 0x0a 0x00 0x02 0x24 0x00
		0x29 0x01 0x00 0x00 0x0a 0x00 0x02 0x25 0x00
		0x29 0x01 0x00 0x00 0x0a 0x00 0x02 0x26 0x00
		0x29 0x01 0x00 0x00 0x0a 0x00 0x02 0x27 0x00
		0x29 0x01 0x00 0x00 0x0a 0x00 0x02 0x28 0x33
		0x29 0x01 0x00 0x00 0x0a 0x00 0x02 0x29 0x03
		0x29 0x01 0x00 0x00 0x0a 0x00 0x02 0x2a 0x00
		0x29 0x01 0x00 0x00 0x0a 0x00 0x02 0x2b 0x00
		0x29 0x01 0x00 0x00 0x0a 0x00 0x02 0x2c 0x00
		0x29 0x01 0x00 0x00 0x0a 0x00 0x02 0x2d 0x00
		0x29 0x01 0x00 0x00 0x0a 0x00 0x02 0x2e 0x00
		0x29 0x01 0x00 0x00 0x0a 0x00 0x02 0x2f 0x00
		0x29 0x01 0x00 0x00 0x0a 0x00 0x02 0x30 0x00
		0x29 0x01 0x00 0x00 0x0a 0x00 0x02 0x31 0x00
		0x29 0x01 0x00 0x00 0x0a 0x00 0x02 0x32 0x00
		0x29 0x01 0x00 0x00 0x0a 0x00 0x02 0x33 0x00
		0x29 0x01 0x00 0x00 0x0a 0x00 0x02 0x34 0x00
		0x29 0x01 0x00 0x00 0x0a 0x00 0x02 0x35 0x00
		0x29 0x01 0x00 0x00 0x0a 0x00 0x02 0x36 0x00
		0x29 0x01 0x00 0x00 0x0a 0x00 0x02 0x37 0x00
		0x29 0x01 0x00 0x00 0x0a 0x00 0x02 0x38 0x00
		0x29 0x01 0x00 0x00 0x0a 0x00 0x02 0x39 0x0f
		0x29 0x01 0x00 0x00 0x0a 0x00 0x02 0x3a 0x2a
		0x29 0x01 0x00 0x00 0x0a 0x00 0x02 0x3b 0x00
		0x29 0x01 0x00 0x00 0x0a 0x00 0x02 0x3c 0x00
		0x29 0x01 0x00 0x00 0x0a 0x00 0x02 0x3d 0x00
		0x29 0x01 0x00 0x00 0x0a 0x00 0x02 0x3e 0x00
		0x29 0x01 0x00 0x00 0x0a 0x00 0x02 0x3f 0x00
		0x29 0x01 0x00 0x00 0x0a 0x00 0x02 0x40 0x00
		0x29 0x01 0x00 0x00 0x0a 0x00 0x02 0x41 0xe0
		0x29 0x01 0x00 0x00 0x0a 0x00 0x02 0x42 0x40
		0x29 0x01 0x00 0x00 0x0a 0x00 0x02 0x43 0x0f
		0x29 0x01 0x00 0x00 0x0a 0x00 0x02 0x44 0x11
		0x29 0x01 0x00 0x00 0x0a 0x00 0x02 0x45 0xa8
		0x29 0x01 0x00 0x00 0x0a 0x00 0x02 0x46 0x00
		0x29 0x01 0x00 0x00 0x0a 0x00 0x02 0x47 0x08
		0x29 0x01 0x00 0x00 0x0a 0x00 0x02 0x48 0x00
		0x29 0x01 0x00 0x00 0x0a 0x00 0x02 0x49 0x01
		0x29 0x01 0x00 0x00 0x0a 0x00 0x02 0x4a 0x00
		0x29 0x01 0x00 0x00 0x0a 0x00 0x02 0x4b 0x00
		0x29 0x01 0x00 0x00 0x0a 0x00 0x02 0x4c 0xb2
		0x29 0x01 0x00 0x00 0x0a 0x00 0x02 0x4d 0x22
		0x29 0x01 0x00 0x00 0x0a 0x00 0x02 0x4e 0x01
		0x29 0x01 0x00 0x00 0x0a 0x00 0x02 0x4f 0xf7
		0x29 0x01 0x00 0x00 0x0a 0x00 0x02 0x50 0x29
		0x29 0x01 0x00 0x00 0x0a 0x00 0x02 0x51 0x72
		0x29 0x01 0x00 0x00 0x0a 0x00 0x02 0x52 0x25
		0x29 0x01 0x00 0x00 0x0a 0x00 0x02 0x53 0xb2
		0x29 0x01 0x00 0x00 0x0a 0x00 0x02 0x54 0x22
		0x29 0x01 0x00 0x00 0x0a 0x00 0x02 0x55 0x22
		0x29 0x01 0x00 0x00 0x0a 0x00 0x02 0x56 0x22
		0x29 0x01 0x00 0x00 0x0a 0x00 0x02 0x57 0xa2
		0x29 0x01 0x00 0x00 0x0a 0x00 0x02 0x58 0x22
		0x29 0x01 0x00 0x00 0x0a 0x00 0x02 0x59 0x01
		0x29 0x01 0x00 0x00 0x0a 0x00 0x02 0x5a 0xe6
		0x29 0x01 0x00 0x00 0x0a 0x00 0x02 0x5b 0x28
		0x29 0x01 0x00 0x00 0x0a 0x00 0x02 0x5c 0x62
		0x29 0x01 0x00 0x00 0x0a 0x00 0x02 0x5d 0x24
		0x29 0x01 0x00 0x00 0x0a 0x00 0x02 0x5e 0xa2
		0x29 0x01 0x00 0x00 0x0a 0x00 0x02 0x5f 0x22
		0x29 0x01 0x00 0x00 0x0a 0x00 0x02 0x60 0x22
		0x29 0x01 0x00 0x00 0x0a 0x00 0x02 0x61 0x22
		0x29 0x01 0x00 0x00 0x0a 0x00 0x02 0x62 0xee
		0x29 0x01 0x00 0x00 0x0a 0x00 0x02 0x63 0x02
		0x29 0x01 0x00 0x00 0x0a 0x00 0x02 0x64 0x0b
		0x29 0x01 0x00 0x00 0x0a 0x00 0x02 0x65 0x02
		0x29 0x01 0x00 0x00 0x0a 0x00 0x02 0x66 0x02
		0x29 0x01 0x00 0x00 0x0a 0x00 0x02 0x67 0x01
		0x29 0x01 0x00 0x00 0x0a 0x00 0x02 0x68 0x00
		0x29 0x01 0x00 0x00 0x0a 0x00 0x02 0x69 0x0f
		0x29 0x01 0x00 0x00 0x0a 0x00 0x02 0x6a 0x07
		0x29 0x01 0x00 0x00 0x0a 0x00 0x02 0x6b 0x55
		0x29 0x01 0x00 0x00 0x0a 0x00 0x02 0x6c 0x02
		0x29 0x01 0x00 0x00 0x0a 0x00 0x02 0x6d 0x02
		0x29 0x01 0x00 0x00 0x0a 0x00 0x02 0x6e 0x5b
		0x29 0x01 0x00 0x00 0x0a 0x00 0x02 0x6f 0x59
		0x29 0x01 0x00 0x00 0x0a 0x00 0x02 0x70 0x02
		0x29 0x01 0x00 0x00 0x0a 0x00 0x02 0x71 0x02
		0x29 0x01 0x00 0x00 0x0a 0x00 0x02 0x72 0x57
		0x29 0x01 0x00 0x00 0x0a 0x00 0x02 0x73 0x02
		0x29 0x01 0x00 0x00 0x0a 0x00 0x02 0x74 0x02
		0x29 0x01 0x00 0x00 0x0a 0x00 0x02 0x75 0x02
		0x29 0x01 0x00 0x00 0x0a 0x00 0x02 0x76 0x02
		0x29 0x01 0x00 0x00 0x0a 0x00 0x02 0x77 0x02
		0x29 0x01 0x00 0x00 0x0a 0x00 0x02 0x78 0x02
		0x29 0x01 0x00 0x00 0x0a 0x00 0x02 0x79 0x02
		0x29 0x01 0x00 0x00 0x0a 0x00 0x02 0x7a 0x0a
		0x29 0x01 0x00 0x00 0x0a 0x00 0x02 0x7b 0x02
		0x29 0x01 0x00 0x00 0x0a 0x00 0x02 0x7c 0x02
		0x29 0x01 0x00 0x00 0x0a 0x00 0x02 0x7d 0x01
		0x29 0x01 0x00 0x00 0x0a 0x00 0x02 0x7e 0x00
		0x29 0x01 0x00 0x00 0x0a 0x00 0x02 0x7f 0x0e
		0x29 0x01 0x00 0x00 0x0a 0x00 0x02 0x80 0x06
		0x29 0x01 0x00 0x00 0x0a 0x00 0x02 0x81 0x54
		0x29 0x01 0x00 0x00 0x0a 0x00 0x02 0x82 0x02
		0x29 0x01 0x00 0x00 0x0a 0x00 0x02 0x83 0x02
		0x29 0x01 0x00 0x00 0x0a 0x00 0x02 0x84 0x5a
		0x29 0x01 0x00 0x00 0x0a 0x00 0x02 0x85 0x58
		0x29 0x01 0x00 0x00 0x0a 0x00 0x02 0x86 0x02
		0x29 0x01 0x00 0x00 0x0a 0x00 0x02 0x87 0x02
		0x29 0x01 0x00 0x00 0x0a 0x00 0x02 0x88 0x56
		0x29 0x01 0x00 0x00 0x0a 0x00 0x02 0x89 0x02
		0x29 0x01 0x00 0x00 0x0a 0x00 0x02 0x8a 0x02
		0x29 0x01 0x00 0x00 0x0a 0x00 0x02 0x8b 0x02
		0x29 0x01 0x00 0x00 0x0a 0x00 0x02 0x8c 0x02
		0x29 0x01 0x00 0x00 0x0a 0x00 0x02 0x8d 0x02
		0x29 0x01 0x00 0x00 0x0a 0x00 0x02 0x8e 0x02
		0x29 0x01 0x00 0x00 0x0a 0x00 0x02 0x8f 0x44
		0x29 0x01 0x00 0x00 0x0a 0x00 0x02 0x90 0x44
		0x29 0x01 0x00 0x00 0x0a 0x00 0x04 0xFF 0x98 0x81 0x02
		0x29 0x01 0x00 0x00 0x0a 0x00 0x15 0x57 0x00 0x1D 0x2B 0x14 0x19 0x2B 0x1F 0x20 0x90 0x1E 0x2A 0x7A 0x19 0x17 0x4A 0x20 0x26 0x4A 0x5B 0x2C
		0x29 0x01 0x00 0x00 0x0a 0x00 0x15 0x6B 0x00 0x1D 0x2B 0x14 0x19 0x2B 0x1F 0x20 0x90 0x1E 0x2A 0x7A 0x19 0x17 0x4A 0x20 0x26 0x4A 0x5B 0x2C
		0x29 0x01 0x00 0x00 0x0a 0x00 0x04 0xFF 0x98 0x81 0x03
		0x29 0x01 0x00 0x00 0x0a 0x00 0x02 0x80 0x4D
		0x29 0x01 0x00 0x00 0x0a 0x00 0x02 0x81 0x45
		0x29 0x01 0x00 0x00 0x0a 0x00 0x02 0x82 0x44
		0x29 0x01 0x00 0x00 0x0a 0x00 0x02 0x83 0x20
		0x29 0x01 0x00 0x00 0x0a 0x00 0x02 0x84 0x00
		0x29 0x01 0x00 0x00 0x0a 0x00 0x04 0xFF 0x98 0x81 0x00
		0x29 0x01 0x00 0x00 0x0a 0x00 0x03 0x51 0x00 0x00
		0x29 0x01 0x00 0x00 0x0a 0x00 0x02 0x53 0x2C
		0x29 0x01 0x00 0x00 0x0a 0x00 0x02 0x55 0x00
		0x29 0x01 0x00 0x00 0x0a 0x00 0x02 0x35 0x00
		0x29 0x01 0x00 0x00 0x0a 0x00 0x02 0x36 0x00
		0x29 0x01 0x00 0x00 0x78 0x01 0x02 0x11 0x00
		0x05 0x01 0x00 0x00 0x32 0x01 0x02 0x29 0x00>;
		lcd-kit,panel-on-cmds-state = "dsi_lp_mode";
		lcd-kit,panel-off-cmds = <0x05 0x01 0x00 0x00 0x28 0x01 0x02 0x28 0x00
		0x05 0x01 0x00 0x00 0x3c 0x01 0x02 0x10 0x00>;
		lcd-kit,panel-off-cmds-state = "dsi_lp_mode";
		lcd-kit,backlight-cmds = <0x29 0x01 0x00 0x00 0x00 0x00 0x03 0x51 0x00 0x00>;
		lcd-kit,backlight-cmds-state = "dsi_lp_mode";
		lcd-kit,tp-color-cmds = <0x06 0x01 0x00 0x00 0x0a 0x00 0x01 0xda>;
		lcd-kit,inversion-dot-cmds = <0x29 0x01 0x00 0x00 0x05 0x01 0x04 0xFF 0x98 0x81 0x02
		0x29 0x01 0x00 0x00 0x0a 0x00 0x02 0x40 0x04
		0x29 0x01 0x00 0x00 0x0a 0x00 0x04 0xFF 0x98 0x81 0x00>;
		lcd-kit,inversion-column-cmds = <0x29 0x01 0x00 0x00 0x05 0x01 0x04 0xFF 0x98 0x81 0x02
		0x29 0x01 0x00 0x00 0x0a 0x00 0x02 0x40 0x00
		0x29 0x01 0x00 0x00 0x0a 0x00 0x04 0xFF 0x98 0x81 0x00>;
		lcd-kit,esd-reg-cmds = <0x06 0x01 0x00 0x00 0x0a 0x00 0x01 0x54
				0x06 0x01 0x00 0x00 0x0a 0x00 0x03 0x09 0x00 0x00>;
		lcd-kit,esd-reg-cmds-state = "dsi_lp_mode";
		lcd-kit,esd-value = <0x2c 0x80 0x03 0x06>;
		lcd-kit,check-reg-cmds = <0x06 0x01 0x00 0x00 0x0a 0x00 0x01 0x0a>;
		lcd-kit,check-reg-cmds-state = "dsi_lp_mode";
		lcd-kit,check-reg-value = <0x9c>;
		lcd-kit,barcode-2d-cmds = <>;
		lcd-kit,project-id-cmds = <>;
		lcd-kit,project-id-cmds-state = "dsi_lp_mode";
		lcd-kit,panel-bl-maxnit-command = <0x06 0x01 0x00 0x00 0x0a 0x00 0x01 0xdb>;
		lcd-kit,panel-bl-maxnit-command-state = "dsi_lp_mode";
		lcd-kit,panel-lcm-type = <2>;
		lcd-kit,panel-ldi-dsi-mode = <1>;
		lcd-kit,panel-dsi-switch-mode = <0>;
		lcd-kit,panel-dsi-switch-mode-en = <0>;
		lcd-kit,panel-ldi-trans-seq = <0>;
		lcd-kit,panel-ldi-data-padding = <0>;
		lcd-kit,panel-ldi-packet-size = <256>;
		lcd-kit,panel-ldi-ps = <2>;
		lcd-kit,panel-vfp-lp = <0>;
		lcd-kit,panel-fbk-div = <1>;
		lcd-kit,panel-orientation = <1>;
		lcd-kit,panel-bpp = <2>;
		lcd-kit,panel-bgr-fmt = <0>;
		lcd-kit,panel-cmd-type = <8>;
		lcd-kit,panel-pxl-clk = <0>;
		lcd-kit,panel-pxl-clk-div = <0>;
		lcd-kit,panel-data-rate = <672>;
		lcd-kit,mipi-lane-nums = <3>;
		lcd-kit,h-back-porch = <70>;
		lcd-kit,h-front-porch = <70>;
		lcd-kit,h-pulse-width = <24>;
		lcd-kit,project-id-support = <0>;
		lcd-kit,default-project-id = "Y1639J1700";
		lcd-kit,v-back-porch = <24>;
		lcd-kit,v-front-porch = <24>;
		lcd-kit,v-pulse-width = <8>;
		lcd-kit,mipi-clk-post-adjust = <0>;
		lcd-kit,mipi-lp11-flag = <0>;
		lcd-kit,esd-support = <1>;
		lcd-kit,esd-recovery-bl-support = <1>;
		lcd-kit,tp-color-support = <0>;
		lcd-kit,lcd-vsp = <2 150 5500000>;
		lcd-kit,lcd-vsn = <2 151 5500000>;
		lcd-kit,lcd-reset = <2 45 0>;
		lcd-kit,power-on-stage = <3 1 0
				4 1 5
				11 1 0
				5 1 1
				5 2 5
				5 1 12
				7 1 0
				6 1 0
				8 1 0>;
		lcd-kit,lp-on-stage = <0 0 0>;
		lcd-kit,hs-on-stage = <0 0 0>;
		lcd-kit,hs-off-stage = <0 0 0>;
		lcd-kit,lp-off-stage = <0 0 0>;
		lcd-kit,power-off-stage = <7 0 0
				6 0 0
				8 0 0
				5 0 10
				4 0 0
				3 0 6>;
		lcd-kit,pt-support = <1>;
		lcd-kit,panel-density = <320>;
		lcd-kit,ssc-disable = <0>;
		lcd-kit,ssc-range = <3>;
		lcd-kit,inversion-support = <1>;
		lcd-kit,check-reg-support = <1>;
		lcd-kit,panel-bl-min = <48>;
		lcd-kit,panel-bl-max = <4095>;
		lcd-kit,panel-bl-max-nit = <450>;
		lcd-kit,mipi-non-continue-enable = <1>;
		lcd-kit,panel-getblmaxnit-type = <1>;
		lcd-kit,panel-bl-ic-ctrl-type = <8>;
		lcd-kit,panel-bias-ic-ctrl-type = <3>;
		lcd-kit,oem-info-support = <0>;
		lcd-kit,oem-barcode-2d-support = <0>;
		lcd-kit,oem-barcode-2d-num-offset = <0>;
		lcd-kit,panel-on-always-reset = <1>;
		lcd-kit,panel-gpio-offset = <329>;
    };
};