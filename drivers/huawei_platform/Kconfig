## drivers/huawei_platform/Kconfig
```kconfig
#=============================================================================
#  add new config for devices check
#  add new config for factory cmdline parse
#  add new config for antenna board gpio match
#=============================================================================

menu "Huawei Platform Drivers"
source "drivers/huawei_platform/hw_kstate/Kconfig"
source "drivers/huawei_platform/antenna_board_gpio_match/Kconfig"
source "drivers/huawei_platform/audio/Kconfig"
source "drivers/huawei_platform/sensors/Kconfig"
source "drivers/huawei_platform/antenna_cable/Kconfig"

# shell thermal config and algorithm AR000AFR67
source "drivers/huawei_platform/huawei_sw_thermal_node/Kconfig"
source "drivers/huawei_platform/sensor/Kconfig"
source "drivers/huawei_platform/ioinfo/Kconfig"
source "drivers/huawei_platform/power/Kconfig"
source "drivers/huawei_platform/pmeminfo/Kconfig"
source "drivers/huawei_platform/card_tray/Kconfig"
source "drivers/huawei_platform/virt_to_phys/Kconfig"
endmenu
```

## drivers/huawei_platform/audio/Kconfig
```kconfig
menu "Audio configuration"
config HUAWEI_AUDIO
        bool "Audio support"
        default n
        select REGMAP_I2C
        help
          Enable support for audio
if HUAWEI_AUDIO
source "drivers/huawei_platform/audio/cs35l41/Kconfig"
source "drivers/huawei_platform/audio/tas2557/Kconfig"
source "drivers/huawei_platform/audio/tfa9894/Kconfig"
source "drivers/huawei_platform/audio/hs_auto_calib/Kconfig"
endif # if HUAWEI_AUDIO
endmenu
```

## drivers/huawei_platform/audio/cs35l41/Kconfig
```kconfig
#
# Misc strange devices
#
config CS35L41
	tristate "Cirrus Logic C35L41 Amplifier misc driver"
	depends on SPI_MASTER
	select  REGMAP_SPI
```

## drivers/huawei_platform/audio/tas2557/Kconfig
```kconfig
menuconfig TAS2557
	tristate "Texas Instruments TAS2557 SmartAmp(R)"

if TAS2557

config TAS2557_REGMAP
    bool "Use of RegMap API"
    default y

config TAS2557_CODEC
    bool "Codec Driver support"
    default n

config TAS2557_MISC
    bool "Misc Driver support"
    default y
	
endif # TAS2557
```

## drivers/huawei_platform/audio/tfa9894/Kconfig
```kconfig
#
# Misc strange devices
#
config TFA9894
	bool "nxp TFA9894 smartpa misc driver"
    default n
```

## drivers/huawei_platform/huawei_sw_thermal_node/Kconfig
```kconfig
# add four node for huawei thermal checking AR000AFR67
config HUAWEI_THERMAL_HWNODE
    tristate "Huawei Kernel State"
    default n
    help
        Huawei kernel state, please choose it.
```

## drivers/huawei_platform/oeminfo/Kconfig
```kconfig
# detect devices

menuconfig HUAWEI_OEMINFO
    bool "HUAWEI OEMINFO"
    default n
    help
      Say yes if you want i2c device detect driver.
      This is for i2c connected version. If unsure, say N here.
```

## drivers/huawei_platform/power/Kconfig
```kconfig
source "drivers/huawei_platform/power/huawei_charger/Kconfig"
source "drivers/huawei_platform/power/eta6937/Kconfig"
source "drivers/huawei_platform/power/rt9471/Kconfig"
source "drivers/huawei_platform/power/sgm41511h/Kconfig"
source "drivers/huawei_platform/power/uscp/Kconfig"
source "drivers/huawei_platform/power/rt9466/Kconfig"
source "drivers/huawei_platform/power/pid_socket/Kconfig"
```

## drivers/md/iocache/Kconfig
```kconfig
config IOCACHE
	default n
	tristate "Volatile memory as cache"
	help
	Allows a block device to be used as cache for other devices; uses
	a btree for indexing and the layout is optimized for SSDs.

config HUAWEI_IOCACHE_DSM
	default n
	depends on IOCACHE
	tristate "Iocache dmd"
	help
	huawei iocache log radar
```

## drivers/misc/mediatek/himntn_kernel/Kconfig
```kconfig
config HIMNTN_FEATURE_SUPPORT
	bool "himntn feature switch"
	default n
	help
	  himntn feature is used to control maintenance,
	  which can be correct partition value in kernel phase.
	  you should set in project configure file.

config MTK_HIMNTN_FEATURE
	bool "mtk platform feature switch"
	default n
	depends on HIMNTN_FEATURE_SUPPORT
	help
	  this feature indicates that it is unique to MTK,
	  which can be used to control MTK feature in kernel phase.
	  you should set in project configure file.
```

## drivers/misc/mediatek/nfc/Kconfig
```kconfig
config NFC_CHIP_NXP
	tristate "PN547 NFC driver"
	depends on I2C
	help
	  NXP PN547 driver.
```

## drivers/misc/mediatek/scp/Kconfig
```kconfig
config MTK_TINYSYS_SCP_SUPPORT
	bool "Specify Interface Support SCP"
	default n
	help
	  SCP is a MediaTek in-house DSP which can receive
	  command from IPI interface.
	  Set Y to enable this feature.
	  If unsure,
	  Set N to stay with legancy feature.
config SENSOR_PARAM_TO_SCP
	bool "Support for Send Sensor Param To SCP"
	default n
	help
	  This open the feature Send Sensor Param
	  to SCP from AP.
	  Select Y if you have such device.
	  If unsure select "N".
```

## drivers/misc/mediatek/sensors-1.0/situation/sar/Kconfig
```kconfig
config MTK_SAR_HUB
	bool "sarthub for MediaTek package"
	default n
	help
	  A sar is a device,
	  usually portable and electronic
	  or electromechanical,
	  that detect distance between the body and device .

source "drivers/misc/mediatek/sensors-1.0/situation/sar/a96t356/Kconfig"
```

## drivers/mmc/Kconfig
```kconfig
#
# MMC subsystem configuration
#

menuconfig MMC
	tristate "MMC/SD/SDIO card support"
	depends on HAS_IOMEM
	help
	  This selects MultiMediaCard, Secure Digital and Secure
	  Digital I/O support.

	  If you want MMC/SD/SDIO support, you should say Y here and
	  also to your specific host controller driver.
config HUAWEI_SDCARD_DSM
	bool "Listen sdcard kernel err"
	depends on MMC != n
	default n
	help
	   use huawei sdcard log radar
config HUAWEI_EMMC_DSM
	bool "Listen eMMC kernel err"
	depends on MMC != n
	default n
	help
	   use huawei emmc log radar

config HUAWEI_STORAGE_ROFA_FOR_MTK
	bool "Huawei storage readonly First Aid module"
	default n
	depends on HUAWEI_STORAGE_ROFA
	help
	  Huawei storage readonly boot solution.

if MMC

source "drivers/mmc/core/Kconfig"

source "drivers/mmc/host/Kconfig"

endif # MMC
```
